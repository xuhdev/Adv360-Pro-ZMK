#define VERSION_MACRO
macro_ver: macro_ver {
compatible = "zmk,behavior-macro";
#binding-cells = <0>;
bindings = <&kp N2>, <&kp N0>, <&kp N2>, <&kp N5>, <&kp N0>, <&kp N2>, <&kp N2>, <&kp N4>, <&kp MINUS>, <&kp M>, <&kp E>, <&kp MINUS>, <&kp C>, <&kp C>, <&kp A>, <&kp N8>, <&kp N8>, <&kp B>, <&kp N5>, <&kp N5>, <&kp A>, <&kp N8>, <&kp N9>, <&kp A>, <&kp MINUS>, <&kp C>, <&kp L>, <&kp I>, <&kp Q>, <&kp U>, <&kp E>, <&kp RET>;
};
